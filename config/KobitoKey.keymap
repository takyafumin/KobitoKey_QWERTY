#include <input/processors.dtsi>
#include <behaviors.dtsi>
#include <dt-bindings/zmk/bt.h>
#include <dt-bindings/zmk/keys.h>
#include <dt-bindings/zmk/pointing.h>

&caps_word { continue-list = <UNDERSCORE BACKSPACE DELETE MINUS>; };

/ {
    combos {
        compatible = "zmk,combos";

        combo_eisu {
            timeout-ms = <50>;
            key-positions = <12 13>;
            bindings = <&kp LANG2>;
        };
